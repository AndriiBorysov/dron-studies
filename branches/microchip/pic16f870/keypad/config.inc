;_CP_ALL                      EQU     H'0FCF'
;_CP_OFF                      EQU     H'3FFF'
;_DEBUG_ON                    EQU     H'37FF'
;_DEBUG_OFF                   EQU     H'3FFF'
;_WRT_ENABLE_ON               EQU     H'3FFF'
;_WRT_ENABLE_OFF              EQU     H'3DFF'
;_CPD_ON                      EQU     H'3EFF'
;_CPD_OFF                     EQU     H'3FFF'
;_LVP_ON                      EQU     H'3FFF' 
;_LVP_OFF                     EQU     H'3F7F'	
;_BODEN_ON                    EQU     H'3FFF'
;_BODEN_OFF                   EQU     H'3FBF'
;_PWRTE_OFF                   EQU     H'3FFF'
;_PWRTE_ON                    EQU     H'3FF7'
;_WDT_ON                      EQU     H'3FFF'
;_WDT_OFF                     EQU     H'3FFB'
;_LP_OSC                      EQU     H'3FFC'
;_XT_OSC                      EQU     H'3FFD'
;_HS_OSC                      EQU     H'3FFE'
;_RC_OSC                      EQU     H'3FFF'

;  __config h'3F3A'

  __config	_CP_OFF & _HS_OSC & _WDT_OFF & _BODEN_OFF & _LVP_OFF